## conf/layer.conf
```bitbake
# We have a conf and classes directory, add to BBPATH
BBPATH .= ":${LAYERDIR}"

# We have recipes-* directories, add to BBFILES
BBFILES += "${LAYERDIR}/recipes-*/*/*.bb \
            ${LAYERDIR}/recipes-*/*/*/*.bbappend \
            ${LAYERDIR}/recipes-*/*/*.bbappend"

BBFILE_COLLECTIONS += "meta-retis"
BBFILE_PATTERN_meta-retis = "^${LAYERDIR}/"
BBFILE_PRIORITY_meta-retis = "7"

LAYERDEPENDS_meta-retis = "core"
LAYERSERIES_COMPAT_meta-retis = "dunfell zeus"

# The target board is selected in the <peta-prof>/build/conf/local.conf, not here
#MACHINE = "zynqmp-generic"

#Prefix to the resulting deployable tarball name
#export IMAGE_BASENAME = "Reference-Minimal-Image"
#MACHINE_NAME ?= "${MACHINE}"
#IMAGE_NAME = "${MACHINE_NAME}_${IMAGE_BASENAME}"

# it is recommended to use a shared directory for different PL projects
#SSTATE_DIR = "/ssd/work/petalinux/sstate/shared-sstate-cache" 
#DL_DIR = "/ssd/work/yocto/rpi3-data/rpi3/downloads/" 
#TMPDIR = "/mnt/yocto/rpi3/tmp" 

# TODO:  wic format is ignored when using petalinux
# this is a smarter image format that can save alot of time when burning a SD card.
# use balena etcher or bmaptool for faster results
#DEPENDS_append = " wic-tools"
#IMAGE_FSTYPES ?= "wic.bz2 wic wic.bmap"
# these are formats generated by default by petalinux which are actually not used, just wasting disk space
#IMAGE_FSTYPES_remove = "cpio.gz cpio cpio.gz.u-boot cpio.bz2"

# the recomended formats are ipk (which uses opkg) or rpm (which uses dnf)
# choose one format so that the package repository does not waste space saving package in multiple formats
PACKAGE_CLASSES = "package_rpm"

# This recipe tracks the 'bleeding edge' linux-xlnx repository.
# Since this tree is frequently updated, AUTOREV is used to track its contents.
#
# To enable this recipe, set PREFERRED_PROVIDER_virtual/kernel = "linux-xlnx-dev"
# ./components/yocto/layers/meta-xilinx/meta-xilinx-bsp/recipes-kernel/linux/linux-xlnx-dev.bb
# Kernel from /opt/yocto/dunfell/src/poky/meta/recipes-kernel/linux/ might also work (e.g. "linux-yocto-rt") althoug it wasnot tested
#PREFERRED_PROVIDER_virtual/kernel = "linux-xlnx-dev"
#PREFERRED_PROVIDER_virtual/kernel = "linux-xlnx"

# removing unsued packages
# https://stackoverflow.com/questions/28765494/yocto-minimal-image-with-package-management
# check the file for the list of features that can be excluded
# /opt/yocto/dunfell/src/poky/meta/recipes-core/packagegroups/packagegroup-base.bb:
# Retis lab usualy dont use these features
#DISTRO_FEATURES_remove = " x11 alsa touchscreen bluetooth opengl wayland 3g nfc apm ext2 nfs phone ppp "
#DISTRO_FEATURES_remove = " pam fbdev xen virtualization openamp"
#PACKAGE_EXCLUDE = "perl5 sqlite3 udev-hwdb bluez3 bluez4"

# can-utils is inserted inthe image by this files
#/ssd/work/petalinux/2020.2/zcu102/components/yocto/layers/meta-petalinux/recipes-core/packagegroups/packagegroup-petalinux-utils.bb
#in the variable RDEPENDS_${PN}. So, to remove this tool, just write:
#RDEPENDS_${PN}_remove += " can-utils"

# used to check the size of the image, the dependency, size of each package, etc
# check the directory build/buildhistory/images/raspberrypi3_64/glibc/core-image-base/
INHERIT += "buildhistory"
BUILDHISTORY_COMMIT = "1"

# example of how to add something to the bootloaded 
#do_deploy_append() {
#    # Enable i2c by default
#    echo "dtparam=i2c_arm=on" >> ${DEPLOYDIR}/bcm2835-bootfiles/config.txt
#}
```
